## Kconfig
```kconfig
config LAYOUT_SHIFT
    bool "Layout Shift"
    default y

if LAYOUT_SHIFT

config LAYOUT_SHIFT_MAX_PRESSED_KEYS
    int "Maximum tracked layout shift key presses"
    default 16
    range 1 255

config LAYOUT_SHIFT_DEBUG
    bool "Layout Shift debug logging"
    depends on LOG

config LAYOUT_SHIFT_PERSISTENT_STATE
    bool "Layout Shift Persistent State"
    default y
    select SETTINGS

endif
```

## boards/shields/chocofi/Kconfig.defconfig
```kconfig
if SHIELD_CHOCOFI_CENTRAL_DONGLE || SHIELD_CHOCOFI_CENTRAL_DONGLE_128X64 || SHIELD_CHOCOFI_CENTRAL_DONGLE_128X32 || SHIELD_CHOCOFI_CENTRAL_LEFT
config ZMK_SPLIT_ROLE_CENTRAL
    default y
endif

if SHIELD_CHOCOFI_CENTRAL_DONGLE || SHIELD_CHOCOFI_CENTRAL_DONGLE_128X64 || SHIELD_CHOCOFI_CENTRAL_DONGLE_128X32
config ZMK_KEYBOARD_NAME
    default "chocofi.dongle"
endif
if SHIELD_CHOCOFI_CENTRAL_LEFT
config ZMK_KEYBOARD_NAME
    default "chocofi.central"
endif
if SHIELD_CHOCOFI_PERIPHERAL_LEFT
config ZMK_KEYBOARD_NAME
    default "chocofi.left"
endif
if SHIELD_CHOCOFI_PERIPHERAL_RIGHT
config ZMK_KEYBOARD_NAME
    default "chocofi.right"
endif

if SHIELD_CHOCOFI_CENTRAL_DONGLE || SHIELD_CHOCOFI_CENTRAL_DONGLE_128X64 || SHIELD_CHOCOFI_CENTRAL_DONGLE_128X32 || SHIELD_CHOCOFI_CENTRAL_LEFT || SHIELD_CHOCOFI_PERIPHERAL_LEFT || SHIELD_CHOCOFI_PERIPHERAL_RIGHT
config ZMK_SPLIT
    default y
config ZMK_SLEEP
    default y
if ZMK_DISPLAY
config I2C
    default y
config SSD1306
    default y
endif
if LVGL
config LV_Z_VDB_SIZE
    default 64
config LV_DPI_DEF
    default 148
config LV_Z_BITS_PER_PIXEL
    default 1
choice LV_COLOR_DEPTH
    default LV_COLOR_DEPTH_1
endchoice
endif
endif
```

## boards/shields/chocofi/Kconfig.shield
```kconfig
# SPDX-License-Identifier: MIT

config SHIELD_CHOCOFI_CENTRAL_DONGLE
    def_bool $(shields_list_contains,chocofi_central_dongle)
config SHIELD_CHOCOFI_CENTRAL_DONGLE_128X64
    def_bool $(shields_list_contains,chocofi_central_dongle_128x64)
config SHIELD_CHOCOFI_CENTRAL_DONGLE_128X32
    def_bool $(shields_list_contains,chocofi_central_dongle_128x32)
config SHIELD_CHOCOFI_CENTRAL_LEFT
    def_bool $(shields_list_contains,chocofi_central_left)
config SHIELD_CHOCOFI_PERIPHERAL_LEFT
    def_bool $(shields_list_contains,chocofi_peripheral_left)
config SHIELD_CHOCOFI_PERIPHERAL_RIGHT
    def_bool $(shields_list_contains,chocofi_peripheral_right)
```

## boards/shields/hana/Kconfig.shield
```kconfig
# Copyright (c) 2020 The ZMK Contributors
# SPDX-License-Identifier: MIT

config SHIELD_HANA_CENTRAL_DONGLE
    def_bool $(shields_list_contains,hana_central_dongle)

config SHIELD_HANA_CENTRAL_DONGLE_128X64
    def_bool $(shields_list_contains,hana_central_dongle_128x64)

config SHIELD_HANA_CENTRAL_DONGLE_128X32
    def_bool $(shields_list_contains,hana_central_dongle_128x32)

config SHIELD_HANA_CENTRAL_LEFT
    def_bool $(shields_list_contains,hana_central_left)

config SHIELD_HANA_PERIPHERAL_LEFT
    def_bool $(shields_list_contains,hana_peripheral_left)

config SHIELD_HANA_PERIPHERAL_RIGHT
    def_bool $(shields_list_contains,hana_peripheral_right)
```

## boards/shields/universal_dongle/Kconfig.defconfig
```kconfig
if SHIELD_UNIVERSAL_DONGLE_128X64

config ZMK_SPLIT_ROLE_CENTRAL
    default y

config ZMK_SPLIT
    default y

config ZMK_KEYBOARD_NAME
    default "universal.dongle"

config SPI
    default y

config I2C
    default y

config ZMK_SLEEP
    default y

if ZMK_DISPLAY

config SSD1306
    default y

choice LV_FONT_DEFAULT
    default LV_FONT_DEFAULT_MONTSERRAT_12
endchoice

choice ZMK_LV_FONT_DEFAULT_SMALL
    default ZMK_LV_FONT_DEFAULT_SMALL_MONTSERRAT_12
endchoice

config LV_Z_VDB_SIZE
    default 64

config LV_DPI_DEF
    default 148

config LV_Z_BITS_PER_PIXEL
    default 1

choice LV_COLOR_DEPTH
    default LV_COLOR_DEPTH_1
endchoice

endif # ZMK_DISPLAY

endif
```

## boards/shields/universal_dongle/Kconfig.shield
```kconfig
config SHIELD_UNIVERSAL_DONGLE_128X64
    def_bool $(shields_list_contains,universal_dongle_128x64)
```

## dts/bindings/behaviors/zmk,behavior-base-view-toggle.yaml
```yaml
description: Persistent BASE display view toggle

compatible: "zmk,behavior-base-view-toggle"

include: zero_param.yaml
```

## dts/bindings/behaviors/zmk,behavior-layout-shift-key-press.yaml
```yaml
description: Layout shift key press behavior
compatible: "zmk,behavior-layout-shift-key-press"
include: one_param.yaml
```

## dts/bindings/behaviors/zmk,behavior-layout-shift-toggle.yaml
```yaml
description: Layout shift toggle behavior
compatible: "zmk,behavior-layout-shift-toggle"
include: zero_param.yaml
properties:
  layout-maps:
    type: phandles
    required: true
  toggle-mode:
    type: string
    required: false
    default: "flip"
    enum: ["on", "off", "flip"]
```

## dts/bindings/behaviors/zmk,behavior-oled-brightness.yaml
```yaml
description: Adjust OLED brightness in bounded steps

compatible: "zmk,behavior-oled-brightness"

include: one_param.yaml
```

## dts/bindings/behaviors/zmk,behavior-oled-toggle.yaml
```yaml
description: Toggle the ZMK display manual power state

compatible: "zmk,behavior-oled-toggle"

include: zero_param.yaml
```

## dts/bindings/behaviors/zmk,behavior-timeout-cycle.yaml
```yaml
description: Cycle Hana runtime timeout selections

compatible: "zmk,behavior-timeout-cycle"

include: one_param.yaml
```

## dts/bindings/zmk,layout-shift-map.yaml
```yaml
description: Layout shift keycode mapping table
compatible: "zmk,layout-shift-map"
properties:
  mappings:
    type: array
    required: true
  priority:
    type: int
    default: 0
```
